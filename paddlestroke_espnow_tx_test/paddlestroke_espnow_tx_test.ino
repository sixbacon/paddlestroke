// paddlestroke_espnow_tx_test.ino
// Synthetic 100 Hz ESPnow transmitter — no IMU hardware required.
// Flash to LOLIN32 Lite (esp32:esp32:lolin32-lite, COM3).
// Pair with paddlestroke_espnow_rx_sdlog on the CYD.
//
// Data is generated by a known formula so the RX can verify integrity:
//   angle      = seq * 2PI / 200          (one full rotation per 200 packets = 2 s)
//   accel_x    = 2.0 * sin(angle)         (m/s²)
//   accel_y    = 2.0 * cos(angle)         (m/s²)
//   accel_z    = 9.80665                  (constant — easy RX cross-check)
//   quaternion = pure Z-axis rotation at 'angle'
//   roll       = 0°  (exact for pure Z rotation)
//   pitch      = 0°  (exact for pure Z rotation)
//   yaw        = angle in degrees, wrapped to (-180, 180]
//   stroke_count increments once every 100 packets (~60 CPM equivalent)
//
// No checksum: ESP-NOW hardware CRC-32 validates every frame.
// Sequence number allows the RX to count lost packets.

#include <WiFi.h>
#include <esp_now.h>
#include <math.h>

#ifndef M_PI
#define M_PI 3.14159265358979323846
#endif

// ── Payload struct — must match RX sketch exactly ─────────────────────────────
struct __attribute__((packed)) ImuDataPayload {
    uint32_t seq;           // monotonic counter; gap = lost packet(s)
    uint32_t timestamp_ms;  // TX millis()
    double   accel_x;       // m/s², = 2·sin(angle)
    double   accel_y;       // m/s², = 2·cos(angle)
    double   accel_z;       // m/s², constant 9.80665
    double   q_w;           // quaternion — pure Z rotation
    double   q_x;
    double   q_y;
    double   q_z;
    double   roll;          // degrees (= 0 for pure Z rotation)
    double   pitch;         // degrees (= 0 for pure Z rotation)
    double   yaw;           // degrees, = angle wrapped to (-180, 180]
    uint32_t stroke_count;  // increments every 100 packets
};
// Size: 4+4 + 10×8 + 4 = 92 bytes (limit 250)
static_assert(sizeof(ImuDataPayload) == 92, "Payload size mismatch — check struct");

#define REPORT_HZ      100
#define REPORT_MS      (1000 / REPORT_HZ)    // 10 ms between packets
#define STROKE_EVERY   100                   // packets per simulated stroke (= 60 CPM)
#define STATS_INTERVAL 5000                  // ms between serial stats

static const uint8_t BROADCAST[] = {0xFF,0xFF,0xFF,0xFF,0xFF,0xFF};

static uint32_t g_seq         = 0;
static uint32_t g_strokeCount = 0;
static uint32_t g_sent        = 0;
static uint32_t g_fail        = 0;
static bool     g_espNowReady = false;

static void initESPNow() {
    if (g_espNowReady) { esp_now_deinit(); g_espNowReady = false; }
    WiFi.mode(WIFI_STA);
    if (esp_now_init() != ESP_OK) {
        Serial.println("ESPnow init FAILED — will retry");
        return;
    }
    esp_now_peer_info_t peer = {};
    memcpy(peer.peer_addr, BROADCAST, 6);
    peer.channel = 1;
    peer.encrypt = false;
    esp_now_add_peer(&peer);
    g_espNowReady = true;
    Serial.println("ESPnow ready — transmitting");
}

void setup() {
    Serial.begin(115200);
    Serial.println("paddlestroke_espnow_tx_test — synthetic 100 Hz transmitter");
    uint8_t mac[6];
    WiFi.macAddress(mac);
    Serial.printf("MAC: %02X:%02X:%02X:%02X:%02X:%02X\n",
                  mac[0], mac[1], mac[2], mac[3], mac[4], mac[5]);
    Serial.printf("Payload size: %u bytes\n", (unsigned)sizeof(ImuDataPayload));
    Serial.printf("Formula: angle = seq * 2PI/200 | accel_z = 9.80665 | roll=pitch=0\n");
    initESPNow();
}

void loop() {
    static unsigned long lastSendMs  = 0;
    static unsigned long lastStatsMs = 0;
    static unsigned long lastRetryMs = 0;

    unsigned long now = millis();

    // Retry ESPnow init if it failed at startup or later
    if (!g_espNowReady) {
        if (now - lastRetryMs >= 10000) {
            lastRetryMs = now;
            Serial.println("Retrying ESPnow init...");
            initESPNow();
        }
        return;
    }

    // Rate-limit to ~100 Hz
    if (now - lastSendMs < REPORT_MS) return;
    lastSendMs = now;

    // ── Generate synthetic data from seq ──────────────────────────────────────
    double angle = g_seq * (2.0 * M_PI / 200.0);   // full rotation per 200 packets

    ImuDataPayload p;
    p.seq          = g_seq;
    p.timestamp_ms = (uint32_t)now;
    p.accel_x      = 2.0 * sin(angle);
    p.accel_y      = 2.0 * cos(angle);
    p.accel_z      = 9.80665;
    p.q_w          = cos(angle / 2.0);
    p.q_x          = 0.0;
    p.q_y          = 0.0;
    p.q_z          = sin(angle / 2.0);
    p.roll         = 0.0;
    p.pitch        = 0.0;
    p.yaw          = angle * (180.0 / M_PI);
    // Wrap yaw to (-180, 180]
    while (p.yaw >  180.0) p.yaw -= 360.0;
    while (p.yaw <= -180.0) p.yaw += 360.0;

    // Increment stroke count every STROKE_EVERY packets
    if (g_seq > 0 && g_seq % STROKE_EVERY == 0) g_strokeCount++;
    p.stroke_count = g_strokeCount;

    // ── Transmit ──────────────────────────────────────────────────────────────
    esp_err_t r = esp_now_send(BROADCAST, (const uint8_t*)&p, sizeof(p));
    if (r == ESP_OK) g_sent++; else g_fail++;
    g_seq++;

    // Serial stats every 5 s (brief — excessive serial slows the loop)
    if (now - lastStatsMs >= STATS_INTERVAL) {
        lastStatsMs = now;
        Serial.printf("TX seq=%u sent=%u fail=%u stroke=%u\n",
                      g_seq, g_sent, g_fail, g_strokeCount);
    }
}
